## Documentation/devicetree/bindings/interrupt-controller/realtek,rtl8196e-intc.txt
```
Realtek RTL8196E SoC interrupt controller

Required properties:

- compatible : should be "realtek,rtl8196e-intc"
- interrupt-controller : Identifies the node as an interrupt controller.
- #interrupt-cells : Specifies the number of cells needed to encode an
  interrupt source. The value shall be 1.
- reg : Specifies base physical address and size of the registers.

Example:

intc: interrupt-controller@B8003000 {
	compatible = "realtek,rtl8196e-intc";
	interrupt-controller;
	#interrupt-cells = <1>;
	reg = <0xB8003000 0x100>;
};
```

## Documentation/devicetree/bindings/timer/realtek,rtl8196e-timer.txt
```
Realtek RTL8196E SoC timer

Required properties:

- compatible : Should be "realtek,rtl8196e-timer".
- reg : Specifies base physical address and size of the registers.
- interrupts : The interrupt number of the timer.
- clocks: phandle to the source clock (usually a 25 MHz fixed clock)

Example:

timer {
	compatible = "realtek,rtl8196e-timer";
	reg = <0xB8003100 0x20>;
	interrupts = <0>;
	clocks = <&sysclk>;
};
```
